## config/west.yml
```yaml
# manifest:
#   remotes:
#     - name: ddpdoj
#       url-base: https://github.com/ddpdoj
#   projects:
#     - name: zmk
#       remote: ddpdoj
#       revision: workflow/metadata-build
#       import: app/west.yml
#   self:
#     path: config

manifest:
  remotes:
    - name: zmkfirmware
      url-base: https://github.com/victorlucachi
  projects:
    - name: zmk
      remote: zmkfirmware
      revision: pmw3610-aml
      import: app/west.yml
  self:
    path: config
```
